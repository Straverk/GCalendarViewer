## components/wifi/Kconfig.projbuild
```kconfig
menu "WiFi Configuration"

    config ESP_WIFI_AP_SSID
        string "WiFi SSID"
        default "myssid"
        help
            SSID (network name) for the example to connect to.

    config ESP_WIFI_AP_PASS
        string "WiFi Password"
        default "mypassword"
        help
            WiFi password (WPA or WPA2) for the example to use.

    config ESP_WIFI_AP_MAX_CONN
        int "Maximal STA connections"
        default 1
        help
            Max number of the STA connects to AP.
endmenu
```
